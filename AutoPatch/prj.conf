## CMakeLists.txt
```
# SPDX-License-Identifier: Apache-2.0

cmake_minimum_required(VERSION 3.20.0)
# set(CONF_FILE ***.conf)
find_package(Zephyr REQUIRED HINTS $ENV{ZEPHYR_BASE})
project(hello_world)

# add_library(myac_obj OBJECT src/LocalPatches/Hotpatch_CVE_10062_1.o)
# add_library(myac_obj OBJECT src/LocalPatches/Hotpatch_CVE_10062_2.o)

# add_library(myac_obj OBJECT src/LocalPatches/Hotpatch_CVE_10021.o)

# add_library(myac_obj OBJECT src/LocalPatches/Hotpatch_CVE_10063.o)

# add_library(myac_obj OBJECT src/LocalPatches/Hotpatch_CVE_10024.o)

# add_library(myac_obj OBJECT src/LocalPatches/Hotpatch_CVE_10028.o)

# add_library(myac_obj OBJECT src/LocalPatches/Hotpatch_CVE_16524.o)

# add_library(myac_obj OBJECT src/LocalPatches/Hotpatch_CVE_16603.o)

# add_library(myac_obj OBJECT src/LocalPatches/Hotpatch_CVE_17443.o)

# add_library(myac_obj OBJECT src/LocalPatches/Hotpatch_CVE_17445.o)

# add_library(myac_obj OBJECT src/LocalPatches/Hotpatch_CVE_10023.o)

# add_library(myac_obj OBJECT src/LocalPatches/Hotpatch_CVE_2784.o)

# add_library(myac_obj OBJECT src/LocalPatches/Hotpatch_CVE_16528_1.o)

# add_library(myac_obj OBJECT src/LocalPatches/Hotpatch_CVE_16528_2.o)



# add_library(myac_obj OBJECT src/LocalPatches/Hotpatch_CVE_16522.o)

# add_library(myac_obj OBJECT src/LocalPatches/Hotpatch_CVE_16526.o)

# add_library(myac_obj OBJECT src/LocalPatches/Hotpatch_CVE_16525.o)

# add_library(myac_obj OBJECT src/LocalPatches/Hotpatch_CVE_16599.o)

# add_library(myac_obj OBJECT src/LocalPatches/Hotpatch_CVE_16523.o)

# add_library(myac_obj OBJECT src/LocalPatches/Hotpatch_CVE_16602.o)

# add_library(myac_obj OBJECT src/LocalPatches/Hotpatch_CVE_16600.o)

# add_library(myac_obj OBJECT src/LocalPatches/Hotpatch_CVE_16527.o)

# add_library(myac_obj OBJECT src/LocalPatches/Hotpatch_CVE_16598.o)

# add_library(myac_obj OBJECT src/LocalPatches/Hotpatch_CVE_14199.o)

# add_library(myac_obj OBJECT src/LocalPatches/Hotpatch_CVE_10019.o)

# add_library(myac_obj OBJECT src/LocalPatches/Hotpatch_CVE_10060.o)

# add_library(myac_obj OBJECT src/LocalPatches/Hotpatch_CVE_10061.o)

# add_library(myac_obj OBJECT src/LocalPatches/Hotpatch_CVE_10066.o)

add_library(myac_obj OBJECT src/LocalPatches/Hotpatch_CVE_10067.o)

# add_library(myac_obj OBJECT src/LocalPatches/Hotpatch_CVE_10069.o)

# add_library(myac_obj OBJECT src/LocalPatches/Hotpatch_CVE_10070.o)

# add_library(myac_obj OBJECT src/LocalPatches/Hotpatch_CVE_10071.o)

# add_library(myac_obj OBJECT src/LocalPatches/Hotpatch_CVE_13602.o)

# add_library(myac_obj OBJECT src/LocalPatches/Hotpatch_CVE_3336.o)

# add_library(myac_obj OBJECT src/LocalPatches/Hotpatch_CVE_24338.o)

# add_library(myac_obj OBJECT src/LocalPatches/Hotpatch_CVE_24338.o)

# add_library(myac_obj OBJECT src/LocalPatches/Hotpatch_CVE_13600.o)

# add_library(myac_obj OBJECT src/LocalPatches/Hotpatch_CVE_16748.o)


set_target_properties(myac_obj PROPERTIES LINKER_LANGUAGE C)

# target_sources(app PRIVATE src/main.c src/LocalPatches/Hotpatch_CVE_10062_1.o)
# target_sources(app PRIVATE src/main.c src/LocalPatches/Hotpatch_CVE_10062_2.o)

# target_sources(app PRIVATE src/main.c src/LocalPatches/Hotpatch_CVE_10021.o)

# target_sources(app PRIVATE src/main.c src/LocalPatches/Hotpatch_CVE_10063.o)

# target_sources(app PRIVATE src/main.c src/LocalPatches/Hotpatch_CVE_10024.o)

# target_sources(app PRIVATE src/main.c src/LocalPatches/Hotpatch_CVE_10028.o)

# target_sources(app PRIVATE src/main.c src/LocalPatches/Hotpatch_CVE_16524.o)

# target_sources(app PRIVATE src/main.c src/LocalPatches/Hotpatch_CVE_16603.o)

# target_sources(app PRIVATE src/main.c src/LocalPatches/Hotpatch_CVE_17443.o)

# target_sources(app PRIVATE src/main.c src/LocalPatches/Hotpatch_CVE_17445.o)

# target_sources(app PRIVATE src/main.c src/LocalPatches/Hotpatch_CVE_10023.o)

# target_sources(app PRIVATE src/main.c src/LocalPatches/Hotpatch_CVE_2784.o)

# target_sources(app PRIVATE src/main.c src/LocalPatches/Hotpatch_CVE_16528_1.o)

# target_sources(app PRIVATE src/main.c src/LocalPatches/Hotpatch_CVE_16528_2.o)

#target_sources(app PUBLIC src/main.c)


# target_sources(app PRIVATE src/main.c src/LocalPatches/Hotpatch_CVE_16522.o)

# target_sources(app PRIVATE src/main.c src/LocalPatches/Hotpatch_CVE_16526.o)

# target_sources(app PRIVATE src/main.c src/LocalPatches/Hotpatch_CVE_16525.o)

# target_sources(app PRIVATE src/main.c src/LocalPatches/Hotpatch_CVE_16599.o)

# target_sources(app PRIVATE src/main.c src/LocalPatches/Hotpatch_CVE_16523.o)

# target_sources(app PRIVATE src/main.c src/LocalPatches/Hotpatch_CVE_16602.o)

# target_sources(app PRIVATE src/main.c src/LocalPatches/Hotpatch_CVE_16600.o)

# target_sources(app PRIVATE src/main.c src/LocalPatches/Hotpatch_CVE_16527.o)

# target_sources(app PRIVATE src/main.c src/LocalPatches/Hotpatch_CVE_16598.o)

# target_sources(app PRIVATE src/main.c src/LocalPatches/Hotpatch_CVE_14199.o)

# target_sources(app PRIVATE src/main.c src/LocalPatches/Hotpatch_CVE_10019.o)

# target_sources(app PRIVATE src/main.c src/LocalPatches/Hotpatch_CVE_10060.o)

# target_sources(app PRIVATE src/main.c src/LocalPatches/Hotpatch_CVE_10061.o)

# target_sources(app PRIVATE src/main.c src/LocalPatches/Hotpatch_CVE_10066.o)

target_sources(app PRIVATE src/main.c src/LocalPatches/Hotpatch_CVE_10067.o)

# target_sources(app PRIVATE src/main.c src/LocalPatches/Hotpatch_CVE_10069.o)

# target_sources(app PRIVATE src/main.c src/LocalPatches/Hotpatch_CVE_10070.o)

# target_sources(app PRIVATE src/main.c src/LocalPatches/Hotpatch_CVE_10071.o)

# target_sources(app PRIVATE src/main.c src/LocalPatches/Hotpatch_CVE_13602.o)

# target_sources(app PRIVATE src/main.c src/LocalPatches/Hotpatch_CVE_3336.o)

# target_sources(app PRIVATE src/main.c src/LocalPatches/Hotpatch_CVE_24338.o)

# target_sources(app PRIVATE src/main.c src/LocalPatches/Hotpatch_CVE_17442.o)

# target_sources(app PRIVATE src/main.c src/LocalPatches/Hotpatch_CVE_13600.o)

# target_sources(app PRIVATE src/main.c src/LocalPatches/Hotpatch_CVE_16748.o)


target_link_libraries(app PRIVATE myac_obj)

set(LLVM_TOOLCHAIN_PATH "~/llvm-project/build" CACHE PATH "Path to LLVM toolchain")
set(ZEPHYR_TOOLCHAIN_VARIANT "llvm" CACHE STRING "Zephyr toolchain variant")

zephyr_include_directories(
  include
  src
)
```

## prj.conf
```kconfig
# CONFIG_NETWORKING=y
# CONFIG_COAP=y
CONFIG_SHELL=y
CONFIG_SHELL_BACKENDS=y
CONFIG_SHELL_BACKEND_DUMMY=y
CONFIG_NEWLIB_LIBC=y
CONFIG_HEAP_MEM_POOL_SIZE=1000
# CONFIG_USERSPACE=y
CONFIG_TIMER_READS_ITS_FREQUENCY_AT_RUNTIME=y
```

## include/ebpf_helper.h
```c
/*
eBPF Helper Lib
*/
// types

typedef unsigned char uint8_t;
typedef unsigned short uint16_t;
typedef unsigned int uint32_t;
typedef unsigned long long uint64_t;

// #define uint8_t bool;
//typedef unsigned char bool;
//#define false (0 != 1)
//#define true (0 == 0)

//#define DEFAULT_MAP 0



inline uint64_t set_return(uint64_t op, uint64_t ret_code) {
	return (op << 32) + ret_code;
}

// status
//const int FILTER_PASS = 0;
//const int FILTER_DROP = 1; // drop with return code
//const int FILTER_REDIRECT = 2; // redirect the return address

// ebpf helpers (must use static)
//static void (*print_log)(char *str) = (void *) 1;
//static void (*c_call)(uint32_t addr, uint32_t arg0, uint32_t arg1, uint32_t arg2, uint32_t arg3) = (void *) 2;
//static void (*map_save_val) (void *mp, uint64_t key, uint64_t val) = (void *) 3;
//static uint64_t (*map_get_val) (void *mp, uint64_t key) = (void *) 4;

// 
```

## include/ebpf_helper_impl.h
```c
#ifndef EBPF_HELPER_IMPL_H_
#define EBPF_HELPER_IMPL_H_
#include "utils.h"
#include "hashmap.h"

struct ebpf_vm;

typedef uint32_t (*c_func)(uint64_t arg0, uint64_t arg1, uint64_t arg2, uint64_t arg3);
extern int ebpf_register(struct ebpf_vm *vm, unsigned int idx, const char *name, void *fn);

void set_default_helpers(struct ebpf_vm *vm);

//#ifdef SYS_CORTEX_M4
static void iot_print_log(char *str) {
	DEBUG_LOG(str);
}

//
// push {arg4, arg5, arg6}
static void iot_call_C_func_noret(uint64_t func_addr, uint64_t arg0, uint64_t arg1, uint64_t arg2, uint64_t arg3) {
	// typedef 
	c_func func = (c_func) (u32) func_addr;
	func(arg0, arg1, arg2, arg3);
	// fp 
	// DEBUG_LOG("%d %d %d %d\n", (u32) arg0, (u32) arg1, (u32) arg2, (u32) arg3);
	DEBUG_LOG("want to call c: func:0x%08x arg0:%d arg1:%d arg2:%d arg3:%d\n",  (u32) func_addr, (u32) arg0, (u32) arg1, (u32) arg2, (u32) arg3);
}

static void iot_call_C_func2_noret(void *arg1, void *arg2) {

}

// static 
static arraymap *amap;
static void tmp_map_save_val(void *mp, uint64_t key, uint64_t val) {
	if (mp == NULL) {
		if (amap == NULL) {
			amap = arraymap_new(5);
		}
		mp = amap;
	}
	arraymap_set(mp, key, val);
}

static uint64_t tmp_map_get_val(void *mp, uint64_t key) {
	return arraymap_get(mp, key);
}

void set_default_helpers(struct ebpf_vm *vm) {
	ebpf_register(vm, 1, "print_log", iot_print_log);
	ebpf_register(vm, 2, "call_c_func", iot_call_C_func_noret);
	// DEBUG_LOG("func 2: 0x%08x\n", iot_call_C_func_noret);
	ebpf_register(vm, 3, "map_set", tmp_map_save_val);
	ebpf_register(vm, 4, "map_get", tmp_map_get_val);
}
// #else
//void set_default_helpers(struct ebpf_vm *vm) {

//}
#endif

//#endif // EBPF_HELPERS_H_
```

## include/ebpf_porting.h
```c
#ifndef EBPF_PORTING_H_
#define EBPF_PORTING_H_

// #include "app/ihp_config.h"

// #define LINUX_TEST
// #define AARH64

//#define RT_THREAD

/*
endian
*/


// #ifdef RT_THREAD
// // https://github.com/RT-Thread/rt-thread/blob/b2e800d1624b444f9ab52d6f5f0050404a94c50a/components/libc/compilers/armlibc/mem_std.c
// #include "rtthread.h"

// #define my_os_malloc rt_malloc
// #define my_os_calloc rt_calloc
// #define my_os_realloc rt_realloc
// #define my_os_free rt_free

// #endif
// #if defined(Win32) || defined(LINUX_TEST)
// #include <stdlib.h>
// #define my_os_malloc malloc
// #define my_os_calloc calloc
// #define my_os_realloc realloc
// #define my_os_free free

// #else

// #if defined(NRF52_NO_OS)

// #define my_os_malloc malloc
// #define my_os_calloc calloc
// #define my_os_realloc realloc
// #define my_os_free free
//#endif // NRF52_NO_OS

//#if defined(ZEPHYR_OS)
// #include <zephyr.h>
#include <zephyr/zephyr.h>


static void* k_realloc(void *rmem, size_t newsize) {
	if (newsize == 0) {
		k_free(rmem);
		return NULL;
	} else if (rmem == NULL) {
		return k_malloc(newsize);
	} else {
		void *pnew = k_malloc(newsize);
		if (pnew) {
			memcpy(pnew, rmem, newsize - 4);
			k_free(rmem);
		}
		return pnew;
	}
}

#define my_os_malloc k_malloc
#define my_os_calloc k_calloc
// #define my_os_realloc k_realloc
#define my_os_free k_free

//#endif // end ZEPHYR_OS

// #ifdef STM32L475_NO_OS
// #include "malloc.h"
// #include <string.h>

// static void* my_malloc(size_t size) {
// 	return mymalloc(1, size);
// }

// static void* my_calloc(size_t nelem, size_t elmsize) {
// 	size_t size = nelem * elmsize;
// 	void *mem = mymalloc(1, size);
// 	memset(mem, 0, size);
// 	return mem;
// }

// static void my_free(void* rmem) {
// 	myfree(1, rmem);
// }

// #define my_os_malloc my_malloc
// #define my_os_calloc my_calloc
// //#define my_os_realloc realloc
// #define my_os_free my_free

// #endif

// #ifdef DEV_QEMU

// #define my_os_malloc malloc
// #define my_os_calloc calloc
// #define my_os_realloc realloc
// #define my_os_free free

// #endif


 
// #endif // else window or Linux


// #ifdef NUTTX_OS
// #define my_os_malloc malloc
// #define my_os_calloc calloc
// #define my_os_realloc realloc
// #define my_os_free free

// #endif

#endif
```

## include/ebpf_types.h
```c
#ifndef UBPF_TYPES_H_
#define UBPF_TYPES_H_
#include "ebpf_porting.h"
#include <stdbool.h>
#include <stdint.h>

#define ARRAY_SIZE(x) (sizeof(x) / sizeof((x)[0]))

// platform 
// x64 ebpf
// #ifdef AARH32
// typedef unsigned long uintptr;
// #else
// typedef unsigned long long uintptr;
// #endif // 

typedef uintptr_t uintptr;

#ifndef NULL
#define NULL 0
#endif


typedef unsigned char		u8;
typedef unsigned short		u16;
typedef unsigned int		u32;
typedef unsigned long long	u64;
typedef signed char		s8;
typedef short			s16;
typedef int				s32;
typedef long long		s64;
typedef unsigned long  sz_t;

#ifndef uint32_t

// typedef u8  uint8_t;
// typedef u16 uint16_t;
// typedef u32 uint32_t;
// typedef u64 uint64_t;
// typedef s8  int8_t;
// typedef s16 int16_t;
// typedef s32 int32_t;
// typedef s64 int64_t;

#endif

#define min(x,y) ({ \
	typeof(x) _x = (x);	\
	typeof(y) _y = (y);	\
	(void) (&_x == &_y);	\
	_x < _y ? _x : _y; })

#define max(x,y) ({ \
	typeof(x) _x = (x);	\
	typeof(y) _y = (y);	\
	(void) (&_x == &_y);	\
	_x > _y ? _x : _y; })

#define min_t(type, a, b) min(((type) a), ((type) b))
#define max_t(type, a, b) max(((type) a), ((type) b))

//#ifndef bool
//typedef int bool;
//#endif
//
//#ifndef true
//#define true 1
//#endif
//
//#ifndef false
//#define false 0
//#endif

static inline u16 __swap16(u16 x)
{
	return (u16) ((((u16)(x) & (u16)0x00ffU) << 8) | (((u16)(x) & (u16)0xff00U) >> 8));
}

static inline u32 __swap32(u32 x) {
	return (u32) ((((u32)(x) & (u32)0x000000ffUL) << 24) |
		(((u32)(x) & (u32)0x0000ff00UL) << 8) | 
		(((u32)(x) & (u32)0x00ff0000UL) >> 8) | 
		(((u32)(x) & (u32)0xff000000UL) >> 24));
}

static inline u64 __swap64(u64 x) {
	return (u64) ((((u64)(x) & (u64)0x00000000000000ffULL) << 56) |
		(((u64)(x) & (u64)0x000000000000ff00ULL) << 40) |
		(((u64)(x) & (u64)0x0000000000ff0000ULL) << 24) |
		(((u64)(x) & (u64)0x00000000ff000000ULL) << 8) |
		(((u64)(x) & (u64)0x000000ff00000000ULL) >> 8) |
		(((u64)(x) & (u64)0x0000ff0000000000ULL) >> 24) |
		(((u64)(x) & (u64)0x00ff000000000000ULL) >> 40) |
		(((u64)(x) & (u64)0xff00000000000000ULL) >> 56));

}


// https://gist.github.com/panzi/6856583
// https://code.woboq.org/gcc/include/bits/byteswap.h.html
// https://elixir.bootlin.com/linux/v5.7.2/source/include/linux/byteorder
#if __BYTE_ORDER == __LITTLE_ENDIAN
// 
	#define my_htole16(x) (x)
	#define my_htole32(x) (x)
	#define my_htole64(x) (x)
// 
	#define my_htobe16(x) __swap16(x)
	#define my_htobe32(x) __swap32(x)
	#define my_htobe64(x) __swap64(x)
#else
// 
	#define my_htole16(x) __swap16(x)
	#define my_htole32(x) __swap32(x)
	#define my_htole64(x) __swap64(x)
// 
	#define my_htobe16(x) (x)
	#define my_htobe32(x) (x)
	#define my_htobe64(x) (x)
#endif

#endif
```

## include/iotpatch.h
```c
#ifndef IOTPATCH_H_
#define IOTPATCH_H_
#include <stdbool.h>
#include <stdint.h>
// #include "patch_point.h"
#include "hashmap.h"
// #include "fixed_patch_points.h"

#define MAX_DP_NUM 6 // maximum dynamic patch num

enum FilterResult {
	FILTER_PASS = 0,
	FILTER_DROP = 1,
	FILTER_REDIRECT = 2,
	FILTER_UNUSED, // do not set patch
};

enum PatchCASFlag {
	FLAG_PATCH_READ,
	FLAG_PATCH_READ_END,
	FLAG_PATCH_WRITE,
	FLAG_PATCH_WRITE_END,
};

typedef enum PatchType {
	FixedPatchPoint = 1,
	DynamicPatchPoint
} PatchType;

// struct FixedPatchPoints;

// read copy update
typedef struct fixed_patch {
	//darray *fixed_patches;
	arraymap *fiexed_patches; // <addr, patch>
} fixed_patch;


// typedef struct dynamic_patch {
// 	struct ebpf_patch *patch;
// 	struct dynamic_patch *next; // *prev
// 	uint32_t inst_addr;
// 	uint32_t pc_addr;
// } dynamic_patch;

typedef struct patch_context {
	int phid;
	uint32_t fbits_filter; // bitmap for active filter patches
	fixed_patch fpatch_list;
	//uint32_t dbits_filter_bpkt; // bloom filter for dynamic patch's bpkt address
	//uint32_t dbits_filter_pc; // bloom filter for dynamic patch's address
	//dynamic_patch dpatch_list; //
	// darray *bpkt;
} patch_context;

extern patch_context pctx;

struct patch_desc;
typedef struct ebpf_patch {
	struct patch_desc *desc;
	struct ebpf_vm *vm;
	bool is_active;
} ebpf_patch;
typedef struct auto_patch {
	struct patch_desc *desc;
	//struct ebpf_vm *vm;
	bool is_active;
} auto_patch;

void init_patch_sys(void);
void destory_patch_context(void);
void destory_ebpf_patch(ebpf_patch *patch);
void show_all_patches(void);

struct patch_desc;
// void active_local_patch(struct ebpf_patch *patch);
void notify_new_patch(struct patch_desc *desc);

auto_patch* get_fixed_patch_by_lr(uint32_t lr);
// patch inst_addr = bpkt_addr
ebpf_patch* get_dynamic_patch_by_bpkt(uint32_t bpkt);
// the next inst addr of the patch addr = pc_addr
ebpf_patch* get_dynamic_patch_by_pc(uint32_t inst_pc);
// inst_addr = fpb_addr (inst_addr | 0x1)
ebpf_patch* get_dynamic_patch_by_fpb(uint32_t fpb_addr);
uint64_t run_ebpf_filter(ebpf_patch *patch, void *args, int args_size);

/*
*/
void load_local_patch_to_ctx(auto_patch *patch);

/*
Patch data serialize
*/
void save_patch_list_to_flash();
void load_patch_list_from_flash();

#endif
```

## include/jit.c
```c
#include "jit.h"
#include "ebpf_allocator.h"
#include "ebpf_vm.h"
// #include "jit_thumb2.c"

#if defined(JIT_STATIC_MEM)
static uint8_t jit_buffer[2048];
static uint8_t offset_mem[1024];

jit_mem g_jit_mem;

jit_mem* jit_mem_allocate(int insts_num) {
	jit_mem *mem = &g_jit_mem;
	mem->code_size = sizeof(jit_buffer);
	mem->jit_code = jit_buffer;
	mem->jmp_offsets = offset_mem;
	memset(jit_buffer, 0, sizeof(jit_buffer));
	memset(offset_mem, 0, sizeof(offset_mem));
	return mem;
}

void jit_mem_free(jit_mem *mem) {
	mem->code_size = 0;
	mem->jit_code = NULL;
	mem->jmp_offsets = NULL;
}

#else

// 
jit_mem* jit_mem_allocate(int insts_num) {
	jit_mem *mem = ebpf_malloc(sizeof(jit_mem));
	mem->code_size = 10 * insts_num + 16;
	mem->jit_code = ebpf_malloc(mem->code_size);
	int offset_size = 4 * insts_num + 16;
	mem->jmp_offsets = ebpf_malloc(offset_size);
	memset(mem->jit_code, 0, mem->code_size);
	memset(mem->jmp_offsets, 0, offset_size);
}

void jit_mem_free(jit_mem *mem) {
	ebpf_free(mem->jit_code);
	ebpf_free(mem->jmp_offsets);
	ebpf_free(mem);
}

#endif

void jit_state_set_mem(jit_state *state, jit_mem *mem) {
	state->jmem = mem;
	state->jit_code = (uint8_t *) ((uint32_t) mem->jit_code & (~0x3));
	state->offsets = (uint32_t *) mem->jmp_offsets;
}

void gen_jit_code(struct ebpf_vm *vm) {
	if (vm->jmem != NULL) {
		jit_mem_free(vm->jmem);
	}
	vm->jmem = jit_mem_allocate(vm->num_insts);
	jit_state state;
	state.insts = vm->insts;
	state.inst_num = vm->num_insts;
	state.idx = 0;
	//state.jit_code = (uint8_t *) ((uint32_t) vm->jmem->jit_code & (~0x3));
	state.err_line = 0;
	state.__bpf_call_base = vm->helper_func->ext_funcs;
	jit_state_set_mem(&state, vm->jmem);
	// jit_compile(&state);
	vm->jit_func = (ebpf_jit_fn) ((uint32_t) vm->jmem->jit_code | 0x1);

// #ifdef SYS_CORTEX_M4
	__asm__("DSB");
	__asm__("ISB");
// #endif
	// jit_dump_inst(&state);
// #ifdef LINUX_TEST
	// jit_dump_inst(&state);
// #endif
}

int jit_mem_statistic(struct ebpf_vm *vm) {
	int code_size = vm->num_insts * 4;
	int jit_size = 10 * vm->num_insts + 16;
	int offset_size = 4 * vm->num_insts + 16;
	int mem = code_size + jit_size + offset_size;
	return code_size;
	// return mem;
}
```

## include/jit_thumb2.h
```c
#ifndef JIT_THUMB2_H_
#define JIT_THUMB2_H_
#include "ebpf_types.h"
#include "utils.h"

// typedef unsigned char		u8;
// typedef unsigned short		u16;
// typedef unsigned int		u32;
// typedef unsigned long long	u64;
// typedef signed char		s8;
// typedef short			s16;
// typedef int				s32;
// typedef long long		s64;

// #define USE_JIT_TEST
// #define DEBUG
// #ifdef DEBUG
// #define DEBUG_LOG(...)								\
// do {												\
// 	my_printf(__VA_ARGS__);							\
// } while (0)
// #else
// #define DEBUG_LOG(...) do {} while(0)
// #endif // end DEBUG

#define ERR_IMM(imm) DEBUG_LOG("Invalide imm value. Line:%d Val:%d\n", __LINE__, imm)

/*
ARM®v7-M Architecture Reference Manual

INSTUCTIONS DEFINES
*/
#define THUMB2_IT 0xbf00
#define THUMB2_MOV_REG 0x4600
#define THUMB2_MOVS_REG 0x0000
#define THUMB2_MOVW_REG 0xea4f0000
#define THUMB2_ASRW_REG 0xfa40f000
#define THUMB2_ASRW_IMM 0xea4f0020
#define THUMB2_LSLW_REG_T2 0xfa00f000
#define THUMB2_LSRW_REG 0xfa20f000
#define THUMB2_LSRW_IMM 0xea4f0010
#define THUMB2_ORRW_REG 0xea400000
#define THUMB2_ORR_REG 0x4300 
#define THUMB2_EOR_REG_T2 0xea800000
#define THUMB2_RSBW_REG 0xebc00000
#define THUMB2_RSBW_IMM 0xf1c00000
#define THUMB2_STR_IMM 0xf8400000
#define THUMB2_STRB_IMM_T3 0xf8000800
#define THUMB2_STRH_IMM_T3 0xf8200800
#define THUMB2_STRD_IMM 0xe8400000
#define THUMB2_LDRB_IMM_T1 0x7800
#define THUMB2_LDRB_IMM_T3 0xf8100000
#define THUMB2_LDR_IMM_T4 0xf8500800
#define THUMB2_LDRD_IMM 0xe8500000
#define THUMB2_PUSH_T1 0xb400
#define THUMB2_PUSH_W 0xe92d0000
#define THUMB2_POP_W 0xe8bd0000
#define THUMB2_SUB_IMM_T1 0x1e00
#define THUMB2_SUB_IMM_T2 0x3800
#define THUMB2_SUB_REG_T1 0x1a00
#define THUMB2_SUB_REG_T2 0xeba00000
#define THUMB2_SUBW_IMM_T4 0xf2a00000
#define THUMB2_ADD_IMM_T2 0x3000
#define THUMB2_ADD_IMM_T4 0xf2000000
#define THUMB2_ADD_REG_T2 0x4400
#define THUMB2_ADDW_REG 0xeb000000
#define THUMB2_AND_REG_T1 0x4000
#define THUMB2_AND_REG_T2 0xea000000
#define THUMB2_CMP_REG_T1 0x4280
#define THUMB2_CMP_REG_T2 0x4500
#define THUMB2_CMPW_REG_T3 0xebb00f00
#define THUMB2_MUL_REG_T2 0xfb00f000
#define THUMB2_SBCW_REG 0xeb600000
#define THUMB2_B_COND_T1 0xd000
#define THUMB2_B_T2 0xe000
#define THUMB2_BLX_REG_T1 0x4780
#define THUMB2_BW_COND_T3 0xf0008000
#define THUMB2_BW_T4 0xf0009000
#define THUMB2_MUL_T2 0xfb00f000
#define THUMB2_UMULL_T2 0xfba00000

#define IT_MASK_NONE 0b1000
#define COND_EQ 0b0000
#define COND_NE 0b0001
#define COND_CS 0b0010
#define COND_CC 0b0011
#define COND_MI 0b0100
#define COND_PL 0b0101
#define COND_VS 0b0110
#define COND_VC 0b0111
#define COND_HI 0b1000
#define COND_LS 0b1001
#define COND_GE 0b1010
#define COND_LT 0b1011
#define COND_GT 0b1100
#define COND_LE 0b1101
#define COND_AL 0b1110 // None, always uncondition

/*
shift LR type: A7-183 A7.4.2 Shift Operations
register shift types
// type: Shift_C(R[m], shift_t, shift_n, APSR.C);
*/
#define SRTYPE_LSL		0
#define SRTYPE_LSR		1
#define SRTYPE_ASR		2
#define SRTYPE_ROR		3
#define SRTYPE_ASL		(SRTYPE_LSL)
/*
Flag S
*/
#define FLAG_NOS   0
#define FLAG_S     1

/*
wback
*/
#define WBACK_NO 0
#define WBACK_YES 1

/*
// sp must 8-bit aligned
// PUSH and POP are always 32-bit, and the addresses of the
// transfers in stack operations must be aligned to 32-bit word boundaries
*/
#define CALLEE_MASK	(1 << ARM_R4 | 1 << ARM_R5 | 1 << ARM_R6 | \
			 1 << ARM_R7 | 1 << ARM_R8 | 1 << ARM_R9 | 1 << ARM_FP)
#define CALLEE_PUSH_MASK (CALLEE_MASK | 1 << ARM_LR)
#define CALLEE_POP_MASK  (CALLEE_MASK | 1 << ARM_PC)

/*
Rd/Rt: destination, dst
Rn: first op, src
Rm: second op, shift base
Rnt: dst and second op
*/

static inline u32 _thumb32_UMULL_T2(s8 RdLo, s8 RdHi, s8 Rn, s8 Rm) {
    return (THUMB2_UMULL_T2) | (Rn << 16) | (RdLo << 12) | (RdHi << 8) | (Rm);
}

static inline u32 _thumb32_MUL_T2(s8 Rd, s8 Rn, s8 Rm) {
    return (THUMB2_MUL_T2) | (Rn << 16) | (Rd << 8) | (Rm);
}

static inline u16 _thumb16_IT_T1(u8 cond, u8 mask) {
    return (THUMB2_IT) | (cond << 4) | (mask);
}

static inline u32 _thumb32_RSBW_IMM_T2(s8 Rd, s8 Rn, s32 shiftImm12, u8 flagS) {
    s32 imm8 = shiftImm12 & 0xff;
    s32 imm3 = (shiftImm12 >> 8) & 0b111;
    s32 i = (shiftImm12 >> 11) & 0x1;
    return (THUMB2_RSBW_IMM) | (i << 26) | (flagS << 20) | (Rn << 16) | (imm3 << 12) | (Rd << 8) | (imm8);
}

static inline u32 _thumb32_RSBW_REG_T1(s8 Rd, s8 Rn, s8 Rm, s32 shiftImm5, u8 srtype, u8 flagS) {
    s32 imm2 = shiftImm5 & 0b11;
    s32 imm3 = (shiftImm5 >> 2) & 0b111;
    return (THUMB2_RSBW_REG) | (flagS << 20) | (Rn << 16) | (imm3 << 12) | (Rd << 8) |
        (imm2 << 6) | (srtype << 4) | (Rm);
}

static inline u16 _thumb16_B_T1(s32 offImm9, s8 cond) {
    u16 imm8 = (offImm9 >> 1) & 0x00ff;
    // DEBUG_LOG("----------------------offset: %d\n", imm8);
    return (THUMB2_B_COND_T1) | (cond << 8) | (imm8);
}

static inline u16 _thumb16_B_T2(s32 offImm12) {
    u16 imm11 = (offImm12 >> 1) & 0x7ff;
    // DEBUG_LOG("----------------------offset: %d\n", imm11);
    return (THUMB2_B_T2) | (imm11);
}

static inline u16 _thumb16_BLX_REG_T1(s8 Rm) {
    return (THUMB2_BLX_REG_T1) | (Rm << 3);
}

static inline u32 _thumb32_BW_T3(s32 offImm20, s8 cond) {
    u32 S = offImm20 < 0;
    u32 imm11 = (offImm20 >> 1) & 0x7ff;
    u32 imm6 = (offImm20 >> 12) & 0x3f;
    u32 J1 = (offImm20 >> 18) & 0x1;
    u32 J2 = (offImm20 >> 19) & 0x1;
    return (THUMB2_BW_COND_T3) | (S << 26) | (cond << 22) | (imm6 << 16) | (J1 << 13) | (J2 << 11) | (imm11);
}

static inline u32 _thumb32_BW_T4(s32 offImm23) {
    s32 S = offImm23 < 0;
    s32 imm11 = (offImm23 >> 1) & 0x7ff;
    s32 imm10 = (offImm23 >> 12) & 0x3ff;
    s32 I1 = (offImm23 >> 18) & 0x1;
    s32 I2 = (offImm23 >> 19) & 0x1;
    s32 J1 = (~I1 ^ S) & 0x1;
    s32 J2 = (~I2 ^ S) & 0x1;
    return (THUMB2_BW_COND_T3) | (S << 26) | (imm10 << 16) | (J1 << 13) | (J2 << 11) | (imm11);
}

static inline u32 _thumb32_SBCW_T2(s8 Rd, s8 Rn, s8 Rm, s32 shiftImm5, u8 srtype, u8 flagS) {
    s32 imm3 = (shiftImm5 >> 2) & 0b111;
    s32 imm2 = shiftImm5 & 0b11;
    return (THUMB2_SBCW_REG) | (flagS << 20) | (Rn << 16) | (imm3 << 12) | (Rd << 8) |
         (imm2 << 6) | (srtype << 4) | (Rm);
}

static inline u16 _thumb16_CMP_REG_T1(s8 Rn, s8 Rm) {
    return (THUMB2_CMP_REG_T1) | (Rm << 3) | (Rn);
}

static inline u16 _thumb16_CMP_REG_T2(s8 Rn, s8 Rm) {
    u16 N = (Rn & 0b1000) >> 3;
    u16 Rn3 = Rn & 0b111;
    return (THUMB2_CMP_REG_T2) | (N << 7) | (Rm << 3) | (Rn3);
}

static inline u32 _thumb32_CMPW_REG_T3(s8 Rn, s8 Rm, s32 offImm5, u8 srtype) {
    u32 imm3 = (offImm5 >> 2) & 0b111;
    u32 imm2 = offImm5 & 0b11;
    return (THUMB2_CMPW_REG_T3) | (Rn << 16) | (imm3 << 12) | 
        (imm2 << 6) | (srtype << 4) | (Rm);
}

static inline u32 _thumb32_MUL_REG_T2(s8 Rd, s8 Rn, s8 Rm) {
    return (THUMB2_MUL_REG_T2) | (Rn << 16) | (Rd << 8) | (Rm);
}

static inline u16 _thumb16_ADD_IMM_T2(s8 RDn, s32 imm8) {
    u16 imm = imm8 & 0xff;
    return (THUMB2_ADD_IMM_T2) | (RDn << 8) | (imm);
}

static inline u32 _thumb32_ADD_IMM_T4(s8 Rd, s8 Rn, s32 imm12) {
    u32 i = (imm12 >> 11) & 0x1;
    u32 imm3 = (imm12 >> 8) & 0b111;
    u32 imm8 = imm12 & 0xff;
    return (THUMB2_ADD_IMM_T4) | (i << 26) | (Rn << 16) | (imm3 << 12) | (Rd << 8) | imm8;
}

static inline u16 _thumb16_ADD_REG_T2(s8 RDn, s8 Rm) {
    u16 DN = (RDn >> 3) & 0x1;
    u16 rdn = RDn & 0b111;
    return (THUMB2_ADD_REG_T2) | (DN << 7) | (Rm << 3) | (rdn);
}

static inline u32 _thumb32_ADDW_REG_T3(s8 Rd, s8 Rn, s8 Rm, s32 offImm5, u8 srtype, u8 flagS) {
    u32 imm3 = (offImm5 >> 2) & 0b111;
    u32 imm2 = offImm5 & 0b11;
    return (THUMB2_ADDW_REG) | (flagS << 20) | (Rn << 16) | (imm3 << 12) | (Rd << 8) | 
        (imm2 << 6) | (srtype << 4) | (Rm);
}

static inline u16 _thumb16_AND_REG_T1(s8 RDn, s8 Rm) {
    return (THUMB2_AND_REG_T1) | (Rm << 3) | (RDn);
}

static inline u32 _thumb32_AND_REG_T2(s8 Rd, s8 Rn, s8 Rm, s32 offImm5, u8 srtype, u8 flagS) {
    u32 imm3 = (offImm5 >> 2) & 0b111;
    u32 imm2 = offImm5 & 0b11;
    return (THUMB2_AND_REG_T2) | (flagS << 20) | (Rn << 16) | (imm3 << 12) | (Rd << 8) | 
        (imm2 << 6) | (srtype << 4) | (Rm);
}


static inline u16 _thumb16_MOV_REG_T1(s8 Rd, s8 Rm) {
    u16 D = (Rd >> 3) & 0b0001;
    u16 Rd3 = Rd & 0b111;
    return (THUMB2_MOV_REG) | (D << 7) | (Rm << 3) | (Rd3);
}

static inline u16 _thumb16_MOVS_REG_T2(s8 Rd, s8 Rm) {
    return (THUMB2_MOVS_REG) | (Rm << 3) | (Rd);
}

static inline u32 _thumb32_MOVW_REG_T3(s8 Rd, s8 Rm, u8 flagS) {
    return (THUMB2_MOVW_REG) | (flagS << 20) | (Rd << 8) | (Rm);
}

static inline u16 _thumb16_SUB_IMM_T1(s8 Rd3, s8 Rn3, s32 imm3) {
    imm3 = imm3 & 0b111;
    return (THUMB2_SUB_IMM_T1) | (imm3 << 6) | (Rn3 << 3) | (Rd3);
}

static inline u16 _thumb16_SUB_IMM_T2(s8 Rdn3, s32 imm8) {
    imm8 = imm8 & 0xff;
    return (THUMB2_SUB_IMM_T2) | (Rdn3 << 8) | imm8;
}

static inline u32 _thumb32_SUBW_IMM_T4(s8 Rd, s8 Rn, s32 imm12, u8 flagS) {
    u32 i = (imm12 >> 11) & 0x1;
    u32 imm3 = (imm12 >> 8) & 0b11;
    u32 imm8 = imm12 & 0xff;
    return (THUMB2_SUBW_IMM_T4) | (i << 26) | (Rn << 16) | (imm3 << 12) | (Rd << 8) | (imm8); 
}

static inline u16 _thumb16_SUB_REG_T1(s8 Rd, s8 Rn, s8 Rm) {
    return (THUMB2_SUB_REG_T1) | (Rm << 6) | (Rn << 3) | (Rd);
}

static inline u32 _thumb32_SUB_REG_T2(s8 Rd, s8 Rn, s8 Rm, s32 shiftOff5, u8 srtype, u8 flagS) {
    u32 imm3 = (shiftOff5 >> 2) & 0b111;
    u32 imm2 = shiftOff5 & 0b11;
    return (THUMB2_SUB_REG_T2) | (flagS << 20) | (Rn << 16) | (imm3 << 12) | (Rd << 8) | (imm2 << 6) | (srtype << 4) | (Rm);
}

static inline u16 _thumb16_PUSH_T1(s32 reg_mask) {
    u16 M = (reg_mask >> 14) & 0x1;
    u16 reg_list = reg_mask & 0xff;
    return (THUMB2_PUSH_T1) | (M << 8) | (reg_list);
}

static inline u32 _thumb32_PUSHW_T2(s32 reg_mask) {
    u32 M = (reg_mask >> 14) & 0x1;
    u32 reg_list = reg_mask & 0x1fff;
    return (THUMB2_PUSH_W) | (M << 14) | (reg_list);
}

static inline u32 _thumb32_POPW_T2(s32 reg_mask) {
    u32 M = (reg_mask >> 14) & 0x1;
    u32 P = (reg_mask >> 15) & 0x1;
    u32 reg_list = reg_mask & 0x1fff;
    return (THUMB2_POP_W) | (P << 15) | (M << 14) | (reg_list);
}

static inline u16 _thumb16_LDRB_IMM_T1(s8 Rt, s8 Rn, s16 offImm5) {
    return (THUMB2_LDRB_IMM_T1) | (offImm5 << 6) | (Rn << 3) | (Rt);
}

static inline u32 _thumb32_LDRB_IMM_T3(s8 Rt, s8 Rn, s32 offImm8) {
    s32 imm8 = offImm8 > 0 ? offImm8 : -offImm8;
    u32 P = 1, U = offImm8 >= 0, W = 0; // p = 0 && w = 0 -> undefined
    u32 flag = 0b1000 | (P << 2) | (U << 1) | W;
    u32 inst = (THUMB2_LDRB_IMM_T3) | (Rn << 16) | (Rt << 12) | (flag << 8) | (imm8);
    // DEBUG_LOG("_thumb32_LDRB_IMM_T3 inst: 0x%08x %d flag=%d\n", inst, imm8, flag);
    return inst;
}

static inline u32 _thumb32_LDR_IMM_T4(s8 Rt, s8 Rn, s32 offImm8) {
    u32 imm8 = offImm8 > 0 ? offImm8 : -offImm8;
    u32 P = offImm8 != 0, U = offImm8 >= 0, W = 0;
    u32 flag = (P << 2) | (U << 1) | W;
    u32 inst = (THUMB2_LDR_IMM_T4) | (Rn << 16) | (Rt << 12) | (flag << 8) | (imm8);
    return inst;
}

static inline u32 _thumb32_LDRD_IMM_T1(s8 Rt[], s8 Rn, s32 offImm8) {
    u32 P = offImm8 != 0, U = offImm8 > 0, W = 0;
    u32 imm8 = offImm8 > 0 ? offImm8 : -offImm8;
    imm8 = (imm8 >> 2) & 0xff;
    u32 flag = 0b0010 | (P << 3) | (U << 2) | W;
    u32 inst = (THUMB2_LDRD_IMM) | (flag << 21) | (Rn << 16) | (Rt[1] << 12) | (Rt[0] << 8) | (imm8);
    // DEBUG_LOG("inst: 0x%08x\n", inst);
    return inst;
}

static inline u32 _thumb32_STRB_IMM_T3(s8 Rn, s8 Rt, s16 offImm8) {
    u32 P = offImm8 != 0;
    u32 U = offImm8 > 0, W = 0;
    u32 imm8 = offImm8 > 0 ? offImm8 : -offImm8;
    u32 flag = 0b111 | (P << 2) | (U << 1) | (W);
    u32 inst = (THUMB2_STRB_IMM_T3) | (Rn << 16) | (Rt << 12) | (flag << 8) | (imm8);
    return inst;
}

static inline u32 _thumb32_STRH_IMM_T3(s8 Rn, s8 Rt, s16 offImm8) {
    u32 P = offImm8 != 0;
    u32 U = offImm8 > 0, W = 0;
    u32 imm8 = offImm8 > 0 ? offImm8 : -offImm8;
    u32 flag = 0b111 | (P << 2) | (U << 1) | (W);
    u32 inst = (THUMB2_STRH_IMM_T3) | (Rn << 16) | (Rt << 12) | (flag << 8) | (imm8);
    return inst;
}

static inline u32 _thumb32_STRD_IMM_T1(s8 RnSrc[], s8 RtDst, s16 offImm8) {
    u32 P = offImm8 != 0;
    u32 U = offImm8 > 0, W = 0;
    u32 imm8 = offImm8 > 0 ? offImm8 : -offImm8;
    imm8 = (imm8 >> 2) & 0xff;
    u32 inst = (THUMB2_STRD_IMM) | (P << 24) | (U << 23) | (W << 22) | 
        (RtDst << 16) | (RnSrc[1] << 12) | (RnSrc[0] << 8) | (imm8);
    // DEBUG_LOG("_thumb32_STRD_IMM_T1: %d %d\n", offImm8, imm8);
    return inst;
}

static inline u32 _thumb32_ASRW_IMM_T2(s8 Rd, s8 Rm, s32 imm5, u8 flagS) {
    u32 imm3 = (imm5 >> 2) & 0b111;
    u32 imm2 = imm5 & 0b11;
    return (THUMB2_ASRW_IMM) | (flagS << 20) | (imm3 << 12) | (Rd << 8) | (imm2 << 6) | (Rm);
}

static inline u32 _thumb32_ASRW_REG_T2(s8 Rd, s8 Rn, s8 Rm, u8 flagS) {
    return (THUMB2_ASRW_REG) | (flagS << 20) | (Rn << 16) | (Rd << 8) | (Rm);
}

static inline u32 _thumb32_LSLW_REG_T2(s8 Rd, s8 Rn, s8 Rm, u8 flagS) {
    return (THUMB2_LSLW_REG_T2) | (flagS << 20) | (Rn << 16) | (Rd << 8) | (Rm);
}

// ARM_MOV_SR
static inline u32 _thumb32_LSRW_REG_T2(s8 Rd, s8 Rn, s8 Rm, u8 flagS) {
    return (THUMB2_LSRW_REG) | (flagS << 20) | (Rn << 16) | (Rd << 8) | (Rm);
}

// ARM_MOV_SI Page A7-282
static inline u32 _thumb32_LSRW_IMM_T2(s8 Rd, s8 Rm, s32 shiftImm5, u8 flagS) {
    if (shiftImm5 < 0 || shiftImm5 > 0b11111) {
        // DEBUG_LOG("Invalide imm value. Line:%d Val:%d\n", __LINE__, shiftImm5);
        return -1;
    }
    u32 imm3 = (shiftImm5 >> 2) & 0b111;
    u32 imm2 = shiftImm5 & 0b11; 
    u32 inst = (THUMB2_LSRW_IMM) | (flagS << 20) | (imm3 << 12) | (Rd << 8) | (imm2 << 6) | (Rm);
    return inst;
}

static inline u16 _thumb16_ORR_REG_T1(s8 RDn, s8 Rm) {
    u16 RDn3 = RDn & 0b111;
    u16 Rm3 = Rm & 0b111;
    return (THUMB2_ORR_REG) | (RDn3 << 4) | (Rm3);
}

static inline u32 _thumb32_EOR_REG_T2(s8 Rd, s8 Rn, s8 Rm, s32 shiftImm5, u8 srtype, u8 flagS) {
    u32 imm3 = (shiftImm5 >> 2) & 0b111;
    u32 imm2 = shiftImm5 & 0b11; 
    return (THUMB2_EOR_REG_T2) | (flagS << 20) | (Rn << 16) | (imm3 << 12)
             | (Rd << 8) | (imm2 << 6) | (srtype << 4) | (Rm); 
}

// ARM_ORR_SI Page A7-310
// type: Shift_C(R[m], shift_t, shift_n, APSR.C);
static inline u32 _thumb32_ORRW_REG_T2(s8 Rd, s8 Rn, s8 Rm, s32 shiftImm5, u8 srtype, u8 flagS) {
    if (shiftImm5 < 0 || shiftImm5 > 0b11111) {
        // DEBUG_LOG("Invalide imm value. Line:%d Val:%d\n", __LINE__, shiftImm5);
        return -1;
    }
    u32 imm3 = (shiftImm5 >> 2) & 0b111;
    u32 imm2 = shiftImm5 & 0b11; 
    u32 inst = (THUMB2_ORRW_REG) | (flagS << 20) | (Rn << 16) | (imm3 << 12)
             | (Rd << 8) | (imm2 << 6) | (srtype << 4) | (Rm); 
    return inst;
}

#ifdef USE_JIT_TEST
static void test_all_inst() {
    DEBUG_LOG("_thumb32_LSRW_IMM_T2: %x -> lsr.w r1, r2, #5\n", _thumb32_LSRW_IMM_T2(1, 2, 5, FLAG_NOS));
    DEBUG_LOG("_thumb32_ORRW_REG_T2: %x -> orr.w r1, r2, r3, lsl #5\n", _thumb32_ORRW_REG_T2(1, 2, 3, 5, SRTYPE_LSL, FLAG_NOS));
}
#endif // USE_JIT_TEST

#endif
```

## include/patch_service.h
```c
#ifndef PATCH_SERVICE_H_
#define PATCH_SERVICE_H_
#include <stdint.h>
#include <stdbool.h>
#include <stddef.h>

/*
Use socket or Uart transfer patch
*/

typedef struct service_context
{
	int pos;
	int sockfd;
	int status;
} service_context;


typedef struct patch_service
{
	service_context *ctx;
	bool (*setup_connect)(service_context *ctx);
	size_t (*receive_buf)(service_context *ctx, uint8_t *buf, size_t len);
	size_t (*send_buf)(service_context *ctx, uint8_t *buf, size_t len);
	void (*dis_connect)(service_context *ctx);
} patch_service;

typedef struct __attribute__((__packed__)) patch_desc {
	const char *cve;
	uint16_t type;
	uint16_t code_len;
	// union {
	// 	uint32_t fixed_id;
	// 	uint32_t inst_addr;
	// };
	uint32_t fixed_id;
	//uint8_t code[0];
	uint64_t (*func) (uint32_t sp);
} patch_desc;

typedef struct __attribute__((aligned(2))) patch_payload {
	uint8_t sign[16];
	// uint16_t pkt_len;
	uint8_t *pkt;
} patch_payload;

// run in new task
bool start_patch_service(void);
bool query_service_alive(void);

#endif
```

## include/utils.h
```c
#ifndef UTILS_H_
#define UTILS_H_
#include <stdint.h>
#include "defs.h"

void debug_log(const char *fmt, ...);
/*
Used for normal debug.
*/
//#define DEBUG
// defined in defs.h 
#ifdef DEBUG 
#define DEBUG_LOG(...)								\
do {												\
	debug_log(__VA_ARGS__);							\
} while (0)
#else
#define DEBUG_LOG(...) do {} while(0)
#endif // end DEBUG

/*
Used in the debug of evaluation functions. Defined in defs.h 
*/
#ifdef USE_TEST_LOG
#define TEST_LOG(...)								\
do {												\
	debug_log(__VA_ARGS__);							\
} while (0)
#else
#define TEST_LOG(...) do {} while(0)
#endif // end TEST_LOG


int str2int(char *str);
int byte2int(uint8_t *buf, int len); // little_edian

// calculate pc address based on inst type (arm32 or thumb16)
uint32_t calc_bpkt_pc(uint32_t inst_addr);

// Thumb32, use get previous inst addr
uint32_t clac_prev_inst_addr(uint32_t next_inst);

uint32_t little_endian_16_bit(uint32_t val);

#endif // end header
```

## src/ebpf_allocator.c
```c
#include "ebpf_allocator.h"
#include "ebpf_porting.h"
#include <string.h>

/*

*/

int mem_size = 0;

void* ebpf_malloc(size_t size) {
	mem_size += size;
	return (void *) my_os_malloc(size);
}

// void* ebpf_realloc(void* rmem, size_t newsize) {
// 	return (void*) my_os_realloc(rmem, newsize);
// }

void* ebpf_realloc(void *rmem, size_t orisize, size_t newsize) {
	mem_size += newsize - orisize;
	if (newsize == 0) {
		ebpf_free(rmem);
		return NULL;
	} else if (rmem == NULL) {
		return ebpf_malloc(newsize);
	} else if (newsize <= orisize) {
		return rmem;
	} else {
		void *pnew = ebpf_malloc(newsize);
		if (pnew != NULL) {
//			uint8_t *xdes = pnew;
//			uint8_t *xsrc = rmem;
//			while(orisize--) *xdes++ = *xsrc++;
			memcpy(pnew, rmem, orisize);
			ebpf_free(rmem);
		}
		return pnew;
	}
}

void* ebpf_calloc(size_t nelem, size_t elmsize) {
	mem_size += elmsize;
	return (void*) my_os_calloc(nelem, elmsize);
}

void ebpf_free(void* rmem) {
	my_os_free(rmem);
}

int get_ebpf_alloc_size() {
	return mem_size;
}
```

## src/hashmap.c
```c
#include "hashmap.h"
#include "ebpf_allocator.h"
#include <stdint.h>
#include <string.h>
# include <stdio.h>
// #include "hotpatch/include/utils.h"

#define MAP_GROW 4

static int binary_search(void **arr, int size, uint32_t val) {
	int start = 0;
	int end = size - 1;
	while (start <= end) {
		int mid = (start + end) / 2;
		int m = (uint32_t) arr[mid];
		if (m == val) {
			return mid;
		} else if (m > val) {
			end = mid - 1;
		} else {
			start = mid + 1;
		}
	}
	return -1;
}

/*
 * lower_bound: find the first one not less than target
 */
static int lower_bound(void **arr, int size, uint32_t val) {
	int start = 0;
	int end = size; // return the tail
	int mid = 0;
	while (start + 1 < end) {
		mid = (start + end) / 2;
		if ((uint32_t) arr[mid] < val) { // (start, mid]
			start = mid;
		} else {
			end = mid;
		}
	}
	return end;
}

static int upper_bound(void **arr, int size, uint32_t val) {
	int start = 0;
	int end = size; // return the tail pos for insert
	int mid = 0;
	while (start + 1 < end) {
		mid = (start + end) / 2;
		if ((uint32_t) arr[mid] <= val) {
			start = mid;
		} else {
			end = mid;
		}
	}
	return end;
}

/*
use array to save a few data with key
*/
darray *darray_new(int initial_size) {
	int data_size = initial_size * sizeof(void *);
	darray *map = ebpf_malloc(sizeof(darray) + data_size);
	map->max_size = initial_size;
	map->cur_size = 0;
	//map->vals = (void **) ebpf_malloc(data_size);
	memset(map->vals, 0, data_size);
	return map;
}

void darray_destroy(darray *arr) {
	//ebpf_free(map->vals);
	ebpf_free(arr);
	arr = NULL;
}

int darray_add(darray *arr, void *val) {
	for (int i = 0; i < arr->cur_size; i++) {
		if (arr->vals[i] == NULL) {
			arr->vals[i] = val;
			return i;
		}
	}
	int idx = arr->cur_size++;
	if (arr->cur_size >= arr->max_size) {
		int new_size = arr->max_size + MAP_GROW;
		int ori_size = sizeof(darray) + arr->max_size * sizeof(void *);
		arr = ebpf_realloc(arr, ori_size, sizeof(darray) + new_size * sizeof(void *));
		arr->max_size = new_size;
	}
	arr->vals[idx] = val;
	return idx;
}

void* darray_get(darray *arr, int key) {
	if (key < arr->cur_size) {
		return arr->vals[key];
	}
	return NULL;
}

void darray_set(darray *arr, int key, void *val) {
	if (key < arr->max_size) {
		arr->vals[key] = val;
	}
}

void darray_del(darray *arr, int key) {
	if (key < arr->cur_size) {
		arr->vals[key] = NULL;
	}
}

arraymap *arraymap_new(int initial_size) {
	arraymap *map = ebpf_malloc(sizeof(arraymap));
	map->cur_size = 0;
	map->max_size = initial_size;
	map->keys = ebpf_malloc(initial_size * sizeof(void *));
	map->vals = ebpf_malloc(initial_size * sizeof(void *));
	return map;
}

void arraymap_destroy(arraymap *map) {
	ebpf_free(map->keys);
	ebpf_free(map->vals);
	ebpf_free(map);
}

int arraymap_set(arraymap *map, void *key, void *val) {
	//printf("The key is 0x%08x \n", (uint32_t)key);

	if (map->cur_size == 0) {
		//printf("a");
		map->keys[0] = key;
		map->vals[0] = val;
		map->cur_size++;
		return 0;
	}
	int insert = lower_bound(map->keys, map->cur_size, (uint32_t) key);
	// printf("Inserting in %d 0x%08x \n ", insert);
	// modify
	if ((uint32_t)(map->keys[insert]) == (uint32_t) key) {
				// printf("b");

		map->vals[insert] = val;
		return;
	}
	// insert
	if (map->cur_size >= map->max_size) {
				// printf("c");

		int new_size = map->max_size + MAP_GROW;
		int ori_size = sizeof(darray) + map->max_size * sizeof(void *);
		map->keys = ebpf_realloc(map->keys, ori_size, new_size * sizeof(void *));
		map->vals = ebpf_realloc(map->vals, ori_size, new_size * sizeof(void *));
		map->max_size = new_size;
	}
	for (int i = map->cur_size; i > insert; i--) {
				// printf("d");

		map->keys[i] = map->keys[i - 1];
		map->vals[i] = map->vals[i - 1];
	}
			// printf("e");

	map->keys[insert] = key;
	map->vals[insert] = val;
	map->cur_size++;
	// printf("%u insert: %d sz: %d\n", (uint32_t) key, insert, map->cur_size);
	return insert;
}

void* arraymap_get(arraymap *map, void * key) {
	int idx = binary_search(map->keys, map->cur_size, (uint32_t) key);
	//printf("search: %d key: %u sz: %d %d\n", idx, key, map->cur_size);
	if (idx != -1) {
		return map->vals[idx];
	}
	return NULL;
}

void* arraymap_iter_key(arraymap *map, int idx) {
	if (idx < 0 || idx >= map->cur_size) {
		return NULL;
	}
	return map->keys[idx];
}

void* arraymap_iter_val(arraymap *map, int idx) {
	if (idx < 0 || idx >= map->cur_size) {
		return NULL;
	}
	return map->vals[idx];
}

void arraymap_del(arraymap *map, void * key) {
	int idx = binary_search(map->keys, map->cur_size, (uint32_t) key);
	if (idx != -1) {
		for (int i = idx; i < map->cur_size; i++) {
			map->keys[i] = map->keys[i + 1];
			map->vals[i] = map->vals[i + 1];
		}
		map->cur_size--;
		map->keys[map->cur_size] = NULL;
		map->vals[map->cur_size] = NULL;
	}
}

/*
Hashmap
*/


/*
Tree map
red-black tree
*/
```

## src/iotpatch.c
```c
#include "iotpatch.h"
#include "utils.h"
//#include "patch_point.h"
#include "patch_service.h"
//#include "ebpf.h"
#include "ebpf_allocator.h"
#include "hashmap.c"
//#include "cortex-m4_fbp.c"
#include "utils.c"

#include <string.h>
#include <stddef.h>
// global patch context
static bool ctx_init = false;
patch_context pctx;

static void update_bits_filter() {
	pctx.fbits_filter = 0;
	printf("Number ****** : %d \n", pctx.fpatch_list.fiexed_patches->cur_size);
	for (int i = 0; i < pctx.fpatch_list.fiexed_patches->cur_size; i++) {
		const auto_patch *patch = arraymap_iter_val(pctx.fpatch_list.fiexed_patches, i);
		printf("Man injam! \n");
		printf("%d %d 0x%08x \n", patch->is_active , patch != NULL , patch->desc->fixed_id); 
		if (patch != NULL && patch->is_active) {
			printf("HHHHHHHHHHHHHH \n");
			pctx.fbits_filter |= patch->desc->fixed_id;
		}
	}

//	pctx.dbits_filter_pc = pctx.dbits_filter_bpkt = 0;
//	dynamic_patch *dp = pctx.dpatch_list.next;
//	while (dp != NULL) {
//		pctx.dbits_filter_pc |= dp->pc_addr;
//		pctx.dbits_filter_bpkt |= dp->inst_addr;
//		dp = dp->next;
//	}
}

auto_patch *auto_patch_setup(patch_desc *desc) {
	auto_patch *patch = ebpf_malloc(sizeof(auto_patch));
	patch->desc = desc;
	patch->is_active = false;
	return patch;
}

// should use lock
// read copy and update
static void active_patch(auto_patch *patch) {
	update_bits_filter();
	if (patch->desc->type == FixedPatchPoint) {
		pctx.fbits_filter |= patch->desc->fixed_id;
		printf("Active fixed patch idx: %d %d\n", patch->desc->fixed_id , pctx.fbits_filter);
	} else if (patch->desc->type == DynamicPatchPoint) {
		// pctx.dbits_filter |= calc_bpkt_pc(patch->desc->inst_addr);
		//add_hw_bkpt(patch->desc->inst_addr);
	}
	
	patch->is_active = true;
}

//static dynamic_patch* add_dynamic_patch_to_ctx(ebpf_patch *patch) {
//	dynamic_patch *dp = pctx.dpatch_list.next;
//	dynamic_patch *cur = NULL, *tail = &pctx.dpatch_list;
//	int cnt = 0;
//	while (dp != NULL) {
//		if (dp->inst_addr == patch->desc->inst_addr) {
//			cur = dp;
//			break;
//		}
//		tail = dp;
//		dp = dp->next;
//		cnt++;
//	}
//	if (cur == NULL) {
//		if (cnt > MAX_DP_NUM) { // overwrite the last one
//			//return NULL;
//			printf("Warning: dynamic patch exceed the maximum number(6).\n");
//			cur = tail;
//		} else {
//			cur = ebpf_malloc(sizeof(dynamic_patch));
//			tail->next = cur;
//		}
//	}
//	cur->next = NULL;
//	cur->inst_addr = calc_bpkt_addr(patch->desc->inst_addr);
//	cur->pc_addr = calc_bpkt_pc(cur->inst_addr);
//	cur->patch = patch;
//	return cur;
//}

static void add_fixed_patch_to_ctx(auto_patch *patch) {
	arraymap_set(pctx.fpatch_list.fiexed_patches, patch->desc->fixed_id, patch);
}

static auto_patch* add_ebpf_patch(patch_desc *desc) {
	auto_patch *patch = auto_patch_setup(desc);
	if (desc->type == FixedPatchPoint) {
		add_fixed_patch_to_ctx(patch);
	} else if (desc->type == DynamicPatchPoint) {
		// desc->inst_addr &= ~0x3; // inst addr should divided by 4
		// add_dynamic_patch_to_ctx(patch);
	}
	return patch;
}

void init_patch_sys(void) {
	if (ctx_init) {
		return;
	}
	int v = 1;
	printf("init_patch_sys: %d\n", v);
	const int init_size = 8;
	memset(&pctx, 0, sizeof(pctx));
	pctx.fpatch_list.fiexed_patches = arraymap_new(4);
	update_bits_filter();
	ctx_init = true;
}

void destory_patch_context() {
	// arraymap_destroy(pctx.fpatch_list.fiexed_patches);
	if (pctx.fpatch_list.fiexed_patches != NULL) {
		arraymap_destroy(pctx.fpatch_list.fiexed_patches);
		pctx.fpatch_list.fiexed_patches = NULL;
	}
//	dynamic_patch *dp = pctx.dpatch_list.next, *next = NULL;
//	while (dp != NULL) {
//		next = dp->next;
//		destory_ebpf_patch(dp->patch);
//		ebpf_free(dp);
//		dp = next;
//	}
	// pctx.fixed_patches = NULL;
//	pctx.dpatch_list.next = NULL;
//	pctx.dbits_filter_bpkt = pctx.dbits_filter_pc = pctx.fbits_filter = 0;
	ctx_init = false;

	// remove all hardware breakpoints
//	clear_all_hw_bkpt();
}

void destory_ebpf_patch(ebpf_patch *patch) {
	if (patch != NULL) {
		ebpf_free(patch->desc);
		ebpf_free(patch->vm);
		ebpf_free(patch);
	}
}

//void show_all_patches(void) {
//	printf("Dynamic Patch List:\n");
//	dynamic_patch *dp = pctx.dpatch_list.next;
//	while (dp != NULL) {
//		printf("dypk inst_addr: 0x%08x pc_addr: 0x%08x is_active: %d\n", dp->inst_addr, dp->pc_addr, dp->patch->is_active);
//		dp = dp->next;
//	}
//
//	printf("Fixed Patch List:\n");
//}

void notify_new_patch(struct patch_desc *desc) {
	printf("New Patch is OK!\n");
	// TODO: only save patch to flash
	auto_patch *patch = add_ebpf_patch(desc);
	// TODO: use lock to load to memory and active patch
	active_patch(patch);
}


// Function to get the number of patches stored in the arraymap
int get_num_patches() {
    if (pctx.fpatch_list.fiexed_patches == NULL) {
        return 0;
    }
    return sizeof(pctx.fpatch_list.fiexed_patches->cur_size);
}


auto_patch* get_fixed_patch_by_lr(uint32_t lr) {
			// printf("patch idx: %d %d\n", pctx.fbits_filter & lr , lr);

	if ((pctx.fbits_filter & lr) != lr) {
				// printf("why?! \n ");

		return NULL;
	}
	// printf("Patch is exist in the arraymap!\n");
	auto_patch *patch = arraymap_get(pctx.fpatch_list.fiexed_patches, lr);
	if (patch != NULL && patch->is_active) {
		printf("Chera?! \n ");
		return patch;
	}
	printf("Chera 2?! \n ");
	return NULL;
}

//ebpf_patch* get_dynamic_patch_by_pc(uint32_t loc) {
//	if ((pctx.dbits_filter_pc & loc) != loc) {
//		return NULL;
//	}
//	dynamic_patch *dp = pctx.dpatch_list.next;
//	while (dp != NULL) {
//		if (dp->pc_addr == loc && dp->patch->is_active) {
//			return dp->patch;
//		}
//		dp = dp->next;
//	}
//	return NULL;
//}

//ebpf_patch* get_dynamic_patch_by_bpkt(uint32_t loc) {
//if ((pctx.dbits_filter_bpkt & loc) != loc) {
//		return NULL;
//	}
//	dynamic_patch *dp = pctx.dpatch_list.next;
//	while (dp != NULL) {
//		if (dp->inst_addr == loc && dp->patch->is_active) {
//			return dp->patch;
//		}
//		dp = dp->next;
//	}
//	return NULL;
//}

//ebpf_patch* get_dynamic_patch_by_fpb(uint32_t fpb_addr) {
//	uint32_t align_addr = fpb_addr & (~0x1);
//	if ((pctx.dbits_filter_bpkt & fpb_addr) == fpb_addr ||
//		(pctx.dbits_filter_bpkt & align_addr) == align_addr) {
//		dynamic_patch *dp = pctx.dpatch_list.next;
//		while (dp != NULL) {
//			if ((dp->inst_addr == fpb_addr || dp->inst_addr == align_addr) && dp->patch->is_active) {
//				return dp->patch;
//			}
//			dp = dp->next;
//		}
//	}
//	return NULL;
//}

void load_local_patch_to_ctx(auto_patch *patch) {
	if (patch->desc->type == FixedPatchPoint) { 
		printf("The description of patch is %s \n", patch->desc->cve);
		add_fixed_patch_to_ctx(patch);
		active_patch(patch);
	} else if (patch->desc->type == DynamicPatchPoint) {
		// the same pointer only add once
//		dynamic_patch *dp = pctx.dpatch_list.next;
//		bool need_insert = true;
//		while (dp != NULL) {
//			if (dp->patch == patch) {
//				need_insert = false;
//				break;
//			}
//			dp = dp->next;
//		}
//		if (need_insert) {
//			dp = add_dynamic_patch_to_ctx(patch);
//		} else { // update current value
//			dp->inst_addr = calc_bpkt_addr(patch->desc->inst_addr);
//			dp->pc_addr = calc_bpkt_pc(dp->inst_addr);
//		}
//		printf("dynamic patch: pc=0x%08x inst=0x%08x\n", dp->pc_addr, dp->inst_addr);
//		active_patch(patch);
	}
}

//uint64_t run_ebpf_filter(ebpf_patch *patch, void *args, int args_size) {
//	if (patch->vm->use_jit) {
//		printf("h1");
//		return patch->vm->jit_func(args, args_size);
//	} else {
//		printf("h2");
//		return ebpf_vm_exec(patch->vm, args, args_size);
//	}
//}
```
